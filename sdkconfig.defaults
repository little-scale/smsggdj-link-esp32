## sdkconfig.defaults
```kconfig
# Defaults applied on a fresh build (committed; sdkconfig itself is git-ignored).

# Ableton Link requires C++ exceptions.
CONFIG_COMPILER_CXX_EXCEPTIONS=y

# Link + asio + WiFi need a large app partition (no OTA).
CONFIG_PARTITION_TABLE_SINGLE_APP_LARGE=y

# 1 kHz tick for the presenter timing / FreeRTOS.
CONFIG_FREERTOS_HZ=1000

# app_main runs the Link object + target loop; give it headroom.
CONFIG_ESP_MAIN_TASK_STACK_SIZE=8192

# The XIAO ESP32-C3's only USB is the USB-Serial/JTAG peripheral; route the
# console there so logs appear over /dev/cu.usbmodem* (default is UART0).
CONFIG_ESP_CONSOLE_USB_SERIAL_JTAG=y
```

## sdkconfig.defaults.esp32s3
```kconfig
# ESP32-S3 extras on top of sdkconfig.defaults (applied after it for this target).
# The S3 adds the USB-MIDI clock source over its USB-OTG peripheral (TinyUSB).

# TinyUSB: one MIDI interface (clock in) + one CDC interface (serial console),
# composited onto the single USB-C connector.
CONFIG_TINYUSB_MIDI_COUNT=1
CONFIG_TINYUSB_CDC_ENABLED=y

# On the S3 the USB-C PHY is taken over by USB-OTG (TinyUSB), so the
# USB-Serial/JTAG console (used on the C3) is unavailable. Early-boot logs go to
# UART0; the interactive console is brought up over USB-CDC at runtime.
# CONFIG_ESP_CONSOLE_USB_SERIAL_JTAG is forced off for this target.
CONFIG_ESP_CONSOLE_USB_SERIAL_JTAG=n
CONFIG_ESP_CONSOLE_UART_DEFAULT=y
```
